## boards/mediatek/mt8196_scp/Kconfig
```kconfig
# SPDX-License-Identifier: Apache-2.0

config BOARD_MT8196_SCP
	select SOC_MT8196_SCP
```

## boards/mediatek/mt8196_scp/Kconfig.defconfig
```kconfig
# SPDX-License-Identifier: Apache-2.0

if BOARD_MT8196_SCP

config BOARD
	default "mt8196_scp"

endif # BOARD_MT8196_SCP
```

## drivers/interrupt_controller/Kconfig.mtk_scp
```kconfig
# SPDX-FileCopyrightText: Copyright (c) 2026 Mediatek
# SPDX-License-Identifier: Apache-2.0

config INTC_MTK_SCP
	bool "MediaTek SCP Interrupt Controller"
	default y
	depends on DT_HAS_MEDIATEK_SCP_INTC_ENABLED
	select MULTI_LEVEL_INTERRUPTS
	select 2ND_LEVEL_INTERRUPTS
	help
	  Enable support for the MediaTek SCP Interrupt Controller.
```

## drivers/serial/Kconfig.mt81xx_scp
```kconfig
# SPDX-FileCopyrightText: Copyright (c) 2026 Mediatek
# SPDX-License-Identifier: Apache-2.0

config UART_MTK_MT81XX_SCP
	bool "MTK MT81xx SCP UART driver"
	default y
	select SERIAL_HAS_DRIVER
	depends on DT_HAS_MEDIATEK_MRV55_UART_ENABLED
	help
	  create driver to handle MT81xx SCP specific UART features.
```

## drivers/timer/Kconfig.mtk_mt81xx_scp
```kconfig
# SPDX-FileCopyrightText: Copyright (c) 2026 Mediatek
# SPDX-License-Identifier: Apache-2.0

config MEDIATEK_MT81XX_SCP_TIMER
	bool "MEDIATEK MT81XX SCP timer driver"
	default y
	depends on DT_HAS_MEDIATEK_MTK_SCP_TIMER_ENABLED
	select TIMER_HAS_64BIT_CYCLE_COUNTER
	help
	  This module implements a kernel device driver for the mt81xx SCP
	  HW timer model
```

## dts/bindings/interrupt-controller/mediatek,scp-intc.yaml
```yaml
# SPDX-FileCopyrightText: Copyright (c) 2026 Mediatek
# SPDX-License-Identifier: Apache-2.0

description: MediaTek SCP Interrupt Controller

compatible: "mediatek,scp-intc"

include: [interrupt-controller.yaml, base.yaml]

properties:
  reg:
    required: true

  interrupts:
    required: true

  "#interrupt-cells":
    const: 3

interrupt-cells:
  - irq
  - polarity
  - group
```

## dts/bindings/ipm/mediatek,mtk-scp-ipm.yaml
```yaml
# SPDX-FileCopyrightText: Copyright (c) 2026 Mediatek
# SPDX-License-Identifier: Apache-2.0

description: MediaTek SCP Inter-Processor Mailbox (IPM)

compatible: "mediatek,mtk-scp-ipm"

include: base.yaml

properties:
  reg:
    required: true
  interrupts:
    required: true
```

## dts/bindings/serial/mediatek,mrv55-uart.yaml
```yaml
# SPDX-FileCopyrightText: Copyright (c) 2026 Mediatek
# SPDX-License-Identifier: Apache-2.0

description: MediaTek MRV55 UART

compatible: "mediatek,mrv55-uart"

include: uart-controller.yaml

properties:
  reg:
    required: true
  clock-frequency:
    type: int
    required: true
    description: Input clock frequency for the UART baudrate generator
```

## dts/bindings/timer/mediatek,mtk-scp-timer.yaml
```yaml
# SPDX-FileCopyrightText: Copyright (c) 2026 Mediatek
# SPDX-License-Identifier: Apache-2.0

description: MediaTek SCP Timer

compatible: "mediatek,mtk-scp-timer"

include: base.yaml

properties:
  reg:
    required: true
  interrupts:
    required: true
```

## soc/mediatek/mt81xx_scp/Kconfig
```kconfig
# SPDX-FileCopyrightText: Copyright (c) 2026 Mediatek
# SPDX-License-Identifier: Apache-2.0

config MEDIATEK_SCP_PROGRAM_LOAD_ADDRESS
	hex "Program load address"
	default 0x1C800000
	help
	  Physical memory address where the host AP loads the SCP firmware image.
```

## soc/mediatek/mt81xx_scp/Kconfig.defconfig
```kconfig
# SPDX-FileCopyrightText: Copyright (c) 2026 Mediatek
# SPDX-License-Identifier: Apache-2.0

if SOC_FAMILY_MT81XX_SCP

config NUM_IRQS
	default 176

config INCLUDE_RESET_VECTOR
	default y

config SYS_CLOCK_HW_CYCLES_PER_SEC
	default $(dt_node_int_prop_int,/cpus/cpu@0,clock-frequency)

config MULTI_LEVEL_INTERRUPTS
	default y

config 2ND_LEVEL_INTERRUPTS
	default y

config MAX_IRQ_PER_AGGREGATOR
	default 160

config 2ND_LVL_ISR_TBL_OFFSET
	default 16

config 2ND_LVL_INTR_00_OFFSET
	default 11

endif # SOC_FAMILY_MT81XX_SCP
```

## soc/mediatek/mt81xx_scp/Kconfig.soc
```kconfig
# SPDX-FileCopyrightText: Copyright (c) 2026 Mediatek
# SPDX-License-Identifier: Apache-2.0

config SOC_FAMILY_MT81XX_SCP
	bool

config SOC_SERIES_MT81XX_SCP
	bool
	select SOC_FAMILY_MT81XX_SCP

config SOC_MT8196_SCP
	bool
	select RISCV
	select RISCV_PRIVILEGED
	select SOC_SERIES_MT81XX_SCP
	select ATOMIC_OPERATIONS_C

config SOC_FAMILY
	default "mt81xx_scp"

config SOC_SERIES
	default "mt81xx_scp"

config SOC
	default "mt8196_scp" if SOC_MT8196_SCP
```
