## boards/mediatek/mt8196_scp/Kconfig.mt8196_scp
```kconfig
# SPDX-FileCopyrightText: Copyright (c) 2026 Mediatek
# SPDX-License-Identifier: Apache-2.0

config BOARD_MT8196_SCP
	select SOC_MT8196_SCP
```

## boards/mediatek/mt8196_scp/board.yml
```yaml
# SPDX-FileCopyrightText: Copyright (c) 2026 Mediatek
# SPDX-License-Identifier: Apache-2.0

boards:
  - name: mt8196_scp
    full_name: MT8196 SCP
    vendor: mediatek
    socs:
      - name: mt8196_scp
```
